// SPDX-License-Identifier: GPL-2.0-or-later OR MIT

#include "qca9558_sophos_apxx.dtsi"

/ {
	compatible = "sophos,ap100", "qca,qca9558";
	model = "Sophos AP100";
};

&gpio_usb_power {
	status = "okay";
};

&usb_phy0 {
	status = "okay";
};

&usb0 {
	status = "okay";
};
