// SPDX-License-Identifier: GPL-2.0-or-later OR MIT

#include "qca9558_sophos_apxx.dtsi"

/ {
	compatible = "sophos,ap55", "qca,qca9558";
	model = "Sophos AP55";
};

&gpio_usb_power {
	status = "okay";
};

&usb_phy0 {
	status = "okay";
};

&usb0 {
	status = "okay";
};
